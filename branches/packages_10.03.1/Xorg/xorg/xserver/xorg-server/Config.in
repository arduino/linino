## branches/packages_10.03.1/Xorg/xorg/xserver/xorg-server/Config.in
```kconfig
menu "kdrive library support"
depends on PACKAGE_xserver-kdrive-xvesa || PACKAGE_xserver-kdrive-xfbdev || PACKAGE_xserver-kdrive-xglamo || PACKAGE_xserver-kdrive-xephyr

	config X_TSLIB
		bool
		prompt "enable support for tslib"

#	config X_XCALIBRATE
#		bool
#		prompt "enable support for xcalibrate"

#	config X_DRI
#		bool
#		prompt "enable support for DRI"

	config X_COMPOSITE
		bool
		prompt "enable support for composite"

	config X_XINERAMA
		bool
		prompt "enable support for xinerama"

#	config X_GLX
#		bool
#		prompt "enable support for GLX"

endmenu
```

## branches/packages_10.03.1/libs/clearsilver/Config.in
```kconfig
config CLEARSILVER_ENABLE_COMPRESSION
	bool "HTML compression support"
	default y if PACKAGE_zlib
	select PACKAGE_zlib

config CLEARSILVER_ENABLE_REMOTE_DEBUGGER
	bool "Remote X CGI debugging"
	default n

config CLEARSILVER_ENABLE_GETTEXT
	bool "Gettext message translation"
	default n
```

## branches/packages_10.03.2/net/samba3/Config.in
```kconfig
config SAMBA3_CONFIG_DEBUG 
	bool "Enable Logging for samba3"
	depends PACKAGE_samba3
	default n
	help
		Enables debugging support (will make binaries *much* bigger)
		Also increases MAX_DEBUG_LEVEL to get more messages (also increases binary sizes!)

config SAMBA3_CONFIG_PRINTING
	bool "Enable shared printing support"
	depends PACKAGE_samba3
	select PACKAGE_cups
	default n
   	help
		Enable shared printing support.
		Adds about 18kB for smbd, about 15kB for nmbd and about 18kB for smbpasswd

config SAMBA3_CONFIG_SMALLER
	bool "Make samba3 even smaller"
	depends PACKAGE_samba3
	default y
	help
		Removes support for ???
		Saves about 18kB for smbd, about 16kB for nmbd and about 17kB for smbpasswd
```

## branches/packages_8.09/multimedia/ffmpeg/Config.in
```kconfig
# FFmpeg configuration

config FFMPEG_FFSERVER_SUPPORT
	bool
	default y if PACKAGE_ffserver
	select FFMPEG_MUXER_ffm
	select FFMPEG_DEMUXER_rtsp
	select FFMPEG_PROTOCOL_rtp

config FFMPEG_LIBDLNA_SUPPORT
	bool
	default y if PACKAGE_libdlna
	select FFMPEG_DECODER_ac3
	select FFMPEG_DECODER_atrac3
	select FFMPEG_DECODER_h264
	select FFMPEG_DECODER_jpegls
	select FFMPEG_DECODER_mp3
	select FFMPEG_DECODER_mpeg1video
	select FFMPEG_DECODER_mpeg2video
	select FFMPEG_DECODER_mpeg4
	select FFMPEG_DECODER_mpeg4aac
	select FFMPEG_DECODER_mpegvideo
	select FFMPEG_DECODER_wmav1
	select FFMPEG_DECODER_wmav2
	select FFMPEG_DECODER_png
	select FFMPEG_DEMUXER_ac3
	select FFMPEG_DEMUXER_h264
	select FFMPEG_DEMUXER_mp3
	select FFMPEG_DEMUXER_mpegvideo

comment "Encoders ---"

config FFMPEG_ENCODER_ac3
	bool
	prompt "AC3"
	select FFMPEG_PARSER_ac3

config FFMPEG_ENCODER_jpegls
	bool
	prompt "JPEG-LS"

config FFMPEG_ENCODER_mpeg1video
	bool
	prompt "MPEG-1 Video"

config FFMPEG_ENCODER_mpeg2video
	bool
	prompt "MPEG-2 Video"

config FFMPEG_ENCODER_mpeg4
	bool
	prompt "MPEG-4"

config FFMPEG_ENCODER_png
	bool
	prompt "PNG"
	select FFMPEG_ENCODER_zlib

config FFMPEG_ENCODER_zlib
	bool
	prompt "Zlib"

comment "Decoders ---"

config FFMPEG_DECODER_ac3
	bool
	prompt "AC3"
	select FFMPEG_PARSER_ac3

config FFMPEG_DECODER_atrac3
	bool
	prompt "ATRAC3"

config FFMPEG_DECODER_gif
	bool
	prompt "GIF"

config FFMPEG_DECODER_h264
	bool
	prompt "H.264"
	select FFMPEG_PARSER_h264

config FFMPEG_DECODER_jpegls
	bool
	prompt "JPEG-LS"

config FFMPEG_DECODER_mp3
	bool
	prompt "MP3"
	select FFMPEG_PARSER_mpegaudio

config FFMPEG_DECODER_mpegvideo
	bool
	prompt "MPEG Video"

config FFMPEG_DECODER_mpeg1video
	bool
	prompt "MPEG-1 Video"

config FFMPEG_DECODER_mpeg2video
	bool
	prompt "MPEG-2 Video"

config FFMPEG_DECODER_mpeg4
	bool
	prompt "MPEG-4"

config FFMPEG_DECODER_mpeg4aac
	bool
	prompt "MPEG-4 (AAC)"

config FFMPEG_DECODER_png
	bool
	prompt "PNG"
	select FFMPEG_DECODER_zlib

config FFMPEG_DECODER_wmav1
	bool
	prompt "WMAv1"

config FFMPEG_DECODER_wmav2
	bool
	prompt "WMAv2"

config FFMPEG_DECODER_zlib
	bool
	prompt "Zlib"

comment "Muxers ---"

config FFMPEG_MUXER_ac3
	bool
	prompt "AC3"
	select FFMPEG_PARSER_ac3

config FFMPEG_MUXER_ffm
	bool
	prompt "FFM (ffserver live feed)"

config FFMPEG_MUXER_h264
	bool
	prompt "H.264"
	select FFMPEG_PARSER_h264

config FFMPEG_MUXER_mp3
	bool
	prompt "MP3"

config FFMPEG_MUXER_mp4
	bool
	prompt "MP4"

config FFMPEG_MUXER_mpeg1video
	bool
	prompt "MPEG-1 Video"

config FFMPEG_MUXER_mpeg2video
	bool
	prompt "MPEG-2 Video"

config FFMPEG_MUXER_mpegts
	bool
	prompt "MPEG-2 (TS)"

config FFMPEG_MUXER_rtp
	bool
	prompt "RTP"

comment "Demuxers ---"

config FFMPEG_DEMUXER_ac3
	bool
	prompt "AC3"
	select FFMPEG_PARSER_ac3

config FFMPEG_DEMUXER_ffm
	bool
	prompt "FFM (ffserver live feed)"

config FFMPEG_DEMUXER_h264
	bool
	prompt "H.264"
	select FFMPEG_PARSER_h264

config FFMPEG_DEMUXER_mp3
	bool
	prompt "MP3"

config FFMPEG_DEMUXER_mpegvideo
	bool
	prompt "MPEG Video"
	select FFMPEG_PARSER_mpegvideo

config FFMPEG_DEMUXER_mpegps
	bool
	prompt "MPEG-2 (PS)"

config FFMPEG_DEMUXER_mpegts
	bool
	prompt "MPEG-2 (TS)"

config FFMPEG_DEMUXER_rtsp
	bool
	prompt "RTSP"
	select FFMPEG_DEMUXER_sdp

config FFMPEG_DEMUXER_sdp
	bool
	prompt "SDP"
	select FFMPEG_DEMUXER_mpegts

comment "Parsers ---"

config FFMPEG_PARSER_ac3
	bool
	prompt "AC3"

config FFMPEG_PARSER_h264
	bool
	prompt "H.264"

config FFMPEG_PARSER_mpegaudio
	bool
	prompt "MPEG Audio"

config FFMPEG_PARSER_mpegvideo
	bool
	prompt "MPEG Video"

config FFMPEG_PARSER_mpeg4video
	bool
	prompt "MPEG-4 Video"

comment "Protocols ---"

config FFMPEG_PROTOCOL_file
	bool
	prompt "file:"

config FFMPEG_PROTOCOL_http
	bool
	prompt "http:"

config FFMPEG_PROTOCOL_pipe
	bool
	prompt "pipe:"

config FFMPEG_PROTOCOL_rtp
	bool
	prompt "rtp:"
	select FFMPEG_PROTOCOL_udp

config FFMPEG_PROTOCOL_tcp
	bool
	prompt "tcp:"

config FFMPEG_PROTOCOL_udp
	bool
	prompt "udp:"
```

## branches/packages_8.09/utils/lcd4linux/Config.in
```kconfig
comment "LCD4Linux Drivers ---"

config LCD4LINUX_DRV_BeckmannEgle
	bool
	prompt "BeckmannEgle"

config LCD4LINUX_DRV_BWCT
	bool
	prompt "BWCT"

config LCD4LINUX_DRV_CrystalFontz
	bool
	prompt "CrystalFontz"

config LCD4LINUX_DRV_Curses
	bool
	prompt "Curses"

config LCD4LINUX_DRV_Cwlinux
	bool
	prompt "Cwlinux"

config LCD4LINUX_DRV_D4D
	bool
	prompt "D4D"

config LCD4LINUX_DRV_G15
	bool
	prompt "G15"

config LCD4LINUX_DRV_HD44780
	bool
	prompt "HD44780"

config LCD4LINUX_DRV_IRLCD
	bool
	prompt "IRLCD"

config LCD4LINUX_DRV_LCD2USB
	bool
	prompt "LCD2USB"

config LCD4LINUX_DRV_LCDLinux
	bool
	prompt "LCDLinux"

config LCD4LINUX_DRV_LCDTerm
	bool
	prompt "LCDTerm"

config LCD4LINUX_DRV_LPH7508
	bool
	prompt "LPH7508"

config LCD4LINUX_DRV_LUIse
	bool
	prompt "LUIse"

config LCD4LINUX_DRV_M50530
	bool
	prompt "M50530"

config LCD4LINUX_DRV_MatrixOrbital
	bool
	prompt "MatrixOrbital"

config LCD4LINUX_DRV_MilfordInstruments
	bool
	prompt "MilfordInstruments"

config LCD4LINUX_DRV_Noritake
	bool
	prompt "Noritake"

config LCD4LINUX_DRV_NULL
	bool
	prompt "NULL"
	default y

config LCD4LINUX_DRV_PNG
	bool
	prompt "PNG"

config LCD4LINUX_DRV_PPM
	bool
	prompt "PPM"

config LCD4LINUX_DRV_Pertelian
	bool
	prompt "Pertelian"

config LCD4LINUX_DRV_picoLCD
	bool
	prompt "picoLCD"

config LCD4LINUX_DRV_PICOLCDGRAPHIC
	bool
	prompt "picoLCDGraphic"

config LCD4LINUX_DRV_RouterBoard
	bool
	depends on TARGET_rb532
	prompt "RouterBoard"

config LCD4LINUX_DRV_serdisplib
	bool
	prompt "serdisplib"

config LCD4LINUX_DRV_SimpleLCD
	bool
	prompt "SimpleLCD"

config LCD4LINUX_DRV_st2205
	bool
	prompt "st2205"

config LCD4LINUX_DRV_T6963
	bool
	prompt "T6963"

config LCD4LINUX_DRV_Trefon
	bool
	prompt "Trefon"

config LCD4LINUX_DRV_USBLCD
	bool
	prompt "USBLCD"

config LCD4LINUX_DRV_USBHUB
	bool
	prompt "USBHUB"

config LCD4LINUX_DRV_ULA200
	bool
	prompt "ULA200"

config LCD4LINUX_DRV_WincorNixdorf
	bool
	prompt "WincorNixdorf"

config LCD4LINUX_DRV_X11
	bool
	prompt "X11"

comment "LCD4Linux Plugins ---"

config LCD4LINUX_PLUGIN_apm
	bool
	prompt "apm"

config LCD4LINUX_PLUGIN_asterisk
	bool
	prompt "asterisk"

config LCD4LINUX_PLUGIN_button_exec
	bool
	prompt "button_exec"

config LCD4LINUX_PLUGIN_cpuinfo
	bool
	prompt "cpuinfo"

config LCD4LINUX_PLUGIN_diskstats
	bool
	prompt "diskstats"

config LCD4LINUX_PLUGIN_dvb
	bool
	prompt "dvb"

config LCD4LINUX_PLUGIN_exec
	bool
	prompt "exec"

config LCD4LINUX_PLUGIN_fifo
	bool
	prompt "fifo"

config LCD4LINUX_PLUGIN_file
	bool
	prompt "file"

config LCD4LINUX_PLUGIN_gps
	bool
	prompt "gps"

config LCD4LINUX_PLUGIN_i2c_sensors
	bool
	prompt "i2c_sensors"

config LCD4LINUX_PLUGIN_iconv
	bool
	prompt "iconv"

config LCD4LINUX_PLUGIN_imon
	bool
	prompt "imon"

config LCD4LINUX_PLUGIN_isdn
	bool
	prompt "isdn"

config LCD4LINUX_PLUGIN_kvv
	bool
	prompt "kvv"

config LCD4LINUX_PLUGIN_loadavg
	bool
	prompt "loadavg"

config LCD4LINUX_PLUGIN_meminfo
	bool
	prompt "meminfo"

config LCD4LINUX_PLUGIN_mpd
	bool
	prompt "mpd"

config LCD4LINUX_PLUGIN_mysql
	bool
	prompt "mysql"

config LCD4LINUX_PLUGIN_pop3
	bool
	prompt "pop3"

config LCD4LINUX_PLUGIN_ppp
	bool
	prompt "ppp"

config LCD4LINUX_PLUGIN_proc_stat
	bool
	prompt "proc_stat"

config LCD4LINUX_PLUGIN_python
	bool
	prompt "python"

config LCD4LINUX_PLUGIN_seti
	bool
	prompt "seti"

config LCD4LINUX_PLUGIN_statfs
	bool
	prompt "statfs"

config LCD4LINUX_PLUGIN_uname
	bool
	prompt "uname"

config LCD4LINUX_PLUGIN_uptime
	bool
	prompt "uptime"

config LCD4LINUX_PLUGIN_wireless
	bool
	prompt "wireless"

config LCD4LINUX_PLUGIN_xmms
	bool
	prompt "xmms"
```

## branches/whiterussian/openwrt/package/dropbear/Config.in
```kconfig
config BR2_PACKAGE_DROPBEAR
	tristate "dropbear - Small SSH 2 client/server"
	default y
	help
	  A small SSH 2 server/client designed for small memory environments.
	  
	  http://matt.ucc.asn.au/dropbear/
	  
config BR2_PACKAGE_DBCONVERT
	tristate "dropbearconvert - utility for converting SSH keys"
	default m if CONFIG_DEVEL
	depends BR2_PACKAGE_DROPBEAR
	  
```

## branches/whiterussian/openwrt/package/ebtables/Config.in
```kconfig
config BR2_PACKAGE_EBTABLES
	tristate "ebtables - Ethernet bridge firewall administration utility"
	default n
	help
	  Ethernet Bridge Firewalling (ebtables)
	  
	  http://ebtables.sourceforge.net/
	  
```
