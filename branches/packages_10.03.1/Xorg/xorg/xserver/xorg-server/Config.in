## branches/whiterussian/openwrt/package/openser/Config.in
```kconfig
menu "openser - Configurable, free SIP server"

config BR2_PACKAGE_OPENSER
	tristate "openser - Configurable, free SIP server"
	default m if CONFIG_DEVEL
	help
	 Open SIP Express Router (OpenSER) is a high-performance,
	 configurable, free SIP server.

config BR2_PACKAGE_OPENSER_MOD_AUTH
	tristate "openser-mod-auth - Authentication support"
	default m
	select BR2_PACKAGE_OPENSER
	help
	  Enable authentication support

config BR2_PACKAGE_OPENSER_MOD_AUTH_DB
	tristate "openser-mod-auth-db - Authentication with database support"
	default m
	select BR2_PACKAGE_OPENSER
	select BR2_PACKAGE_OPENSER_MOD_AUTH
	help
	  Enable authentication with database support

config BR2_PACKAGE_OPENSER_MOD_AUTH_RADIUS
	tristate "openser-mod-auth-radius - Authentication with RADIUS support"
	default m
	select BR2_PACKAGE_OPENSER
	select BR2_PACKAGE_LIBRADIUSCLIENT_NG
	help
	  Authentication against RADIUS

config BR2_PACKAGE_OPENSER_MOD_AVP_RADIUS
        tristate "openser-mod-avp-radius - AVP with RADIUS support"
        default m
        select BR2_PACKAGE_OPENSER
	select BR2_PACKAGE_LIBRADIUSCLIENT_NG
        help
          Enable AVP with RADIUS support

config BR2_PACKAGE_OPENSER_MOD_AVPOPS
	tristate "openser-mod-avpops - AVP options support"
	default m
	select BR2_PACKAGE_OPENSER
	help
	  Enable AVP options support

config BR2_PACKAGE_OPENSER_MOD_DISPATCHER
        tristate "openser-mod-dispatcher - dispatcher support"
        default m
        select BR2_PACKAGE_OPENSER
        help
          Enable dispatcher options support

config BR2_PACKAGE_OPENSER_MOD_DIVERSION
        tristate "openser-mod-diversion - diversion support"
        default m
        select BR2_PACKAGE_OPENSER
        help
          Enable diversion options support

config BR2_PACKAGE_OPENSER_MOD_FLATSTORE
        tristate "openser-mod-flatstore - flatstore support"
        default m
        select BR2_PACKAGE_OPENSER
        help
          Enable flatstore support

config BR2_PACKAGE_OPENSER_MOD_GFLAGS
        tristate "openser-mod-gflags - gflags support"
        default m
        select BR2_PACKAGE_OPENSER
        help
          Enable GFlags support

config BR2_PACKAGE_OPENSER_MOD_GROUP
        tristate "openser-mod-group - group support"
        default m
        select BR2_PACKAGE_OPENSER
        help
          Enable group support

config BR2_PACKAGE_OPENSER_MOD_GROUP_RADIUS
        tristate "openser-mod-group-radius - group with RADIUS support"
        default m
        select BR2_PACKAGE_OPENSER
        help
          Enable group with RADIUS support

config BR2_PACKAGE_OPENSER_MOD_LCR
        tristate "openser-mod-lcr - Least Cost Routing support"
        default m
        select BR2_PACKAGE_OPENSER
        select BR2_PACKAGE_OPENSER_MOD_MYSQL
        help
          Enable Least Cost Routing support

config BR2_PACKAGE_OPENSER_MOD_MEDIAPROXY
	tristate "openser-mod-mediaproxy - Mediaproxy support"
	default m
	select BR2_PACKAGE_OPENSER
	help
	  Enable mediaproxy support

config BR2_PACKAGE_OPENSER_MOD_MSILO
        tristate "openser-mod-msilo - MSilo support"
        default m
        select BR2_PACKAGE_OPENSER
        help
          Enable msilo support

config BR2_PACKAGE_OPENSER_MOD_MYSQL
        tristate "openser-mod-mysql - MySQL support"
        default m
        select BR2_PACKAGE_LIBMYSQLCLIENT
        select BR2_PACKAGE_OPENSER
        help
          Enable MySQL support

config BR2_PACKAGE_OPENSER_MOD_NATHELPER
	tristate "openser-mod-nathelper - NAT helper support"
	default m
	select BR2_PACKAGE_OPENSER
	help
	  NAT helper support

config BR2_PACKAGE_OPENSER_MOD_OPTIONS
        tristate "openser-mod-options - options support"
        default m
        select BR2_PACKAGE_OPENSER
        help
          Enable options support

config BR2_PACKAGE_OPENSER_MOD_PDT
        tristate "openser-mod-pdt - PDT support"
        default m
        select BR2_PACKAGE_OPENSER
        help
          Enable pdt support

config BR2_PACKAGE_OPENSER_MOD_PERMISSIONS
        tristate "openser-mod-permissions - Permissions support"
        default m
        select BR2_PACKAGE_OPENSER
        help
          Enable permissions support

config BR2_PACKAGE_OPENSER_MOD_PIKE
        tristate "openser-mod-pike - PIKE support"
        default m
        select BR2_PACKAGE_OPENSER
        help
          Enable pike support

config BR2_PACKAGE_OPENSER_MOD_SMS
	tristate "openser-mod-sms - SMS support"
	default m
	select BR2_PACKAGE_OPENSER
	help
	  SMS support

config BR2_PACKAGE_OPENSER_MOD_SPEEDDIAL
	tristate "openser-mod-speeddial - Speed dial support"
	default m
	select BR2_PACKAGE_OPENSER
	help
	  Speed Dial support

config BR2_PACKAGE_OPENSER_MOD_UAC
        tristate "openser-mod-uac - UAC support"
        default m
        select BR2_PACKAGE_OPENSER
        help
          Enable UAC support

config BR2_PACKAGE_OPENSER_MOD_UAC_REDIRECT
        tristate "openser-mod-uac - UAC redirect support"
        default m
        select BR2_PACKAGE_OPENSER
        help
          Enable UAC redirect support

config BR2_PACKAGE_OPENSER_MOD_URI
        tristate "openser-mod-uri - URI support"
        default m
        select BR2_PACKAGE_OPENSER
        help
          Enable URI support

config BR2_PACKAGE_OPENSER_MOD_URI_DB
        tristate "openser-mod-uri-db - URI database support"
        default m
        select BR2_PACKAGE_OPENSER
        help
          Enable URI database support

config BR2_PACKAGE_OPENSER_MOD_URI_RADIUS
        tristate "openser-mod-uri-radius - URI with RADIUS support"
        default m
        select BR2_PACKAGE_OPENSER
        help
          Enable URI with RADIUS support

config BR2_PACKAGE_OPENSER_MOD_XLOG
	tristate "openser-mod-xlog - Logging support"
	default m
	select BR2_PACKAGE_OPENSER
	help
	  Logging support

endmenu
```

## branches/whiterussian/openwrt/package/pcmcia-cs/Config.in
```kconfig
config BR2_COMPILE_PCMCIA_CS
	tristate
	default n
	depends BR2_PACKAGE_PCMCIA_UTILS

config BR2_PACKAGE_PCMCIA_UTILS
	tristate "pcmcia-utils - PCMCIA/Cardbus management utilities"
	select BR2_COMPILE_PCMCIA_CS
	select BR2_PACKAGE_KMOD_PCMCIA
	default m
	help
	  PCMCIA/Cardbus management utilities
	  
	  http://pcmcia-cs.sourceforge.net/
```

## branches/whiterussian/openwrt/package/pptp/Config.in
```kconfig
config BR2_PACKAGE_PPTP
	prompt "pptp - PPTP (Point-to-Point Tunneling Protocol) client"
	tristate
	default m if CONFIG_DEVEL
	default m if BR2_PACKAGE_IMAGEBUILDER
	select BR2_PACKAGE_KMOD_GRE
	select BR2_PACKAGE_PPP
	help
	  A Point-to-Point Tunneling Protocol Client 
	  
	  http://pptpclient.sourceforge.net/
	  
```

## branches/whiterussian/openwrt/package/psmisc/Config.in
```kconfig
menu "Misc /proc utilities"

config BR2_PACKAGE_PSMISC
	prompt "Misc /proc utilities"
	tristate
	default m if CONFIG_DEVEL
	help
	PSmisc package is a set of additional small useful utilities that use
	the proc filesystem: fuser, killall, pstree, and pidof
	
	http://psmisc.sourceforge.net/

config BR2_PACKAGE_PSMISC_FUSER
	prompt "fuser - identify processes using files or sockets"
	bool
	default y if CONFIG_DEVEL
	depends BR2_PACKAGE_PSMISC

config BR2_PACKAGE_PSMISC_KILLALL
	prompt "killall - kill process by name, pidof - find PIDs by name"
	bool
	default y if CONFIG_DEVEL
	depends BR2_PACKAGE_PSMISC

config BR2_PACKAGE_PSMISC_PSTREE
	prompt "pstree (requires libncurses) - display a tree of processes"
	bool
	default y if CONFIG_DEVEL
	depends BR2_PACKAGE_PSMISC
	select BR2_PACKAGE_LIBNCURSES

endmenu
```

## branches/whiterussian/openwrt/package/qos-scripts/Config.in
```kconfig
config BR2_PACKAGE_QOS_SCRIPTS
	tristate "QoS scripts."
	default m if CONFIG_DEVEL
	select BR2_PACKAGE_IPROUTE2_TC
	select BR2_PACKAGE_KMOD_SCHED
	select BR2_PACKAGE_IPTABLES_MOD_FILTER
	select BR2_PACKAGE_IPTABLES_MOD_IPOPT
	select BR2_PACKAGE_IPTABLES_MOD_EXTRA
	select BR2_PACKAGE_IPTABLES_MOD_CONNTRACK
	select BR2_PACKAGE_IPTABLES_MOD_IMQ
	help
	 A set of scripts that abstract QoS configuration
	 into a simple configuration file supporting stanzas that specify
	 any number of QoS entries.
```

## branches/whiterussian/openwrt/package/stunnel/Config.in
```kconfig
config BR2_PACKAGE_STUNNEL
	tristate "stunnel - openssl wrapper"
	select BR2_PACKAGE_LIBOPENSSL
	select BR2_PACKAGE_LIBWRAP
	default m if CONFIG_DEVEL
	help

	Stunnel is a program that allows you to encrypt arbitrary TCP connections
	inside SSL (Secure Sockets Layer) available on both Unix and Windows.
	Stunnel can allow you to secure non-SSL aware daemons and protocols
	(like POP, IMAP, LDAP, etc) by having Stunnel provide the encryption,
	requiring no changes to the daemon's code.

	The Stunnel source code is not a complete product -- you still require a
	functioning SSL library such as OpenSSL or SSLeay in order to compile
	stunnel. This means that stunnel can support whatever (and only) that
	which your SSL library can, without making any changes in the Stunnel code.

	http://www.stunnel.org/
```

## branches/whiterussian/openwrt/package/webif/Config.in
```kconfig
menu "webif - OpenWrt Administrative Console"

config BR2_PACKAGE_WEBIF
	select BR2_PACKAGE_HASERL
	tristate "webif - OpenWrt Administrative Console"
	default y
	help
	  A web interface for configuring OpenWrt
	  
config BR2_PACKAGE_WEBIF_LANG_CA
	select BR2_PACKAGE_HASERL
	tristate "webif-lang-ca - Canadian language file for webif"
	depends BR2_PACKAGE_WEBIF
	default m
	help
	  Canadian language file for webif

config BR2_PACKAGE_WEBIF_LANG_CZ
	select BR2_PACKAGE_HASERL
	tristate "webif-lang-cz - Czech language file for webif"
	depends BR2_PACKAGE_WEBIF
	default m
	help
	  Czech language file for webif

config BR2_PACKAGE_WEBIF_LANG_DE
	select BR2_PACKAGE_HASERL
	tristate "webif-lang-de - German language file for webif"
	depends BR2_PACKAGE_WEBIF
	default m
	help
	  German language file for webif

config BR2_PACKAGE_WEBIF_LANG_DK
	select BR2_PACKAGE_HASERL
	tristate "webif-lang-dk - Danish language file for webif"
	depends BR2_PACKAGE_WEBIF
	default m
	help
	  Danish language file for webif

config BR2_PACKAGE_WEBIF_LANG_EE
	select BR2_PACKAGE_HASERL
	tristate "webif-lang-ee - Estonian language file for webif"
	depends BR2_PACKAGE_WEBIF
	default m
	help
	  Estonian language file for webif

config BR2_PACKAGE_WEBIF_LANG_ES
	select BR2_PACKAGE_HASERL
	tristate "webif-lang-es - Spanish language file for webif"
	depends BR2_PACKAGE_WEBIF
	default m
	help
	  Spanish language file for webif

config BR2_PACKAGE_WEBIF_LANG_FR
	select BR2_PACKAGE_HASERL
	tristate "webif-lang-fr - French language file for webif"
	depends BR2_PACKAGE_WEBIF
	default m
	help
	  French language file for webif

config BR2_PACKAGE_WEBIF_LANG_HR
	select BR2_PACKAGE_HASERL
	tristate "webif-lang-hr - Croatian language file for webif"
	depends BR2_PACKAGE_WEBIF
	default m
	help
	  Croatian language file for webif

config BR2_PACKAGE_WEBIF_LANG_HU
	select BR2_PACKAGE_HASERL
	tristate "webif-lang-hu - Hungarian language file for webif"
	depends BR2_PACKAGE_WEBIF
	default m
	help
	  Hungarian language file for webif

config BR2_PACKAGE_WEBIF_LANG_IT
	select BR2_PACKAGE_HASERL
	tristate "webif-lang-it - Italian language file for webif"
	depends BR2_PACKAGE_WEBIF
	default m
	help
	  Italian language file for webif

config BR2_PACKAGE_WEBIF_LANG_NL
	select BR2_PACKAGE_HASERL
	tristate "webif-lang-nl - Dutch language file for webif"
	depends BR2_PACKAGE_WEBIF
	default m
	help
	  Dutch language file for webif

config BR2_PACKAGE_WEBIF_LANG_NO
	select BR2_PACKAGE_HASERL
	tristate "webif-lang-no - Norwegian language file for webif"
	depends BR2_PACKAGE_WEBIF
	default m
	help
	  Norwegian language file for webif

config BR2_PACKAGE_WEBIF_LANG_PL
	select BR2_PACKAGE_HASERL
	tristate "webif-lang-pl - Polish language file for webif"
	depends BR2_PACKAGE_WEBIF
	default m
	help
	  Polish language file for webif

config BR2_PACKAGE_WEBIF_LANG_RU
	select BR2_PACKAGE_HASERL
	tristate "webif-lang-ru - Russian language file for webif"
	depends BR2_PACKAGE_WEBIF
	default m
	help
	  Russian language file for webif

config BR2_PACKAGE_WEBIF_LANG_SE
	select BR2_PACKAGE_HASERL
	tristate "webif-lang-se - Swedish language file for webif"
	depends BR2_PACKAGE_WEBIF
	default m
	help
	  Swedish language file for webif
endmenu
```
