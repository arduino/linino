## branches/whiterussian/openwrt/target/linux/Config.in
```kconfig
config BR2_LINUX_2_4
	bool "Linux 2.4"
	default y

config BR2_LINUX_2_4_BRCM
	bool "Support for Broadcom based routers"
	default y
	help
	  Build firmware images for Broadcom based routers
          (e.g. Linksys WRT54G(S), Asus WL-500g, Motorola WR850G)
		               
	  This one builds the generic .trx images, activate one of the
	  options below for creating device specific files for use 
	  with TFTP client too. 

comment "Kernel Modules"

config BR2_PACKAGE_KMOD_DIAG
	tristate "Router LED/Button Driver"
	default y
	help
	  Driver for the LEDs on Wireless Routers (diag)

config BR2_PACKAGE_KMOD_BRCM_WL
	tristate "Broadcom Wireless Network Driver"
	depends BR2_LINUX_2_4_BRCM
	default y
	help
	  Proprietary driver for Broadcom Wireless chipsets

config BR2_PACKAGE_KMOD_BRCM_ET
	tristate "Broadcom Ethernet Driver"
	depends BR2_LINUX_2_4_BRCM
	default m
	help
	  Proprietary driver for Broadcom Ethernet chipsets

config BR2_PACKAGE_KMOD_ARPT
	tristate "ARP firewalling support"
	default m
	help
	  Kernel modules for ARP firewalling

config BR2_PACKAGE_KMOD_EBT
	tristate "Ethernet Bridge firewalling support"
	default m
	help
	  Kernel modules for bridge firewalling

config BR2_PACKAGE_KMOD_IPTABLES_EXTRA
	tristate "Extra Netfilter modules for IPv4 firewalling (meta-package)"
	default m
	select BR2_PACKAGE_KMOD_IPT_CONNTRACK
	select BR2_PACKAGE_KMOD_IPT_FILTER
	select BR2_PACKAGE_KMOD_IPT_IPOPT
	select BR2_PACKAGE_KMOD_IPT_IPSEC
	select BR2_PACKAGE_KMOD_IPT_NAT
	select BR2_PACKAGE_KMOD_IPT_NAT_EXTRA
	select BR2_PACKAGE_KMOD_IPT_QUEUE
	select BR2_PACKAGE_KMOD_IPT_ULOG
	select BR2_PACKAGE_KMOD_IPT_EXTRA
	help
	  Extra Netfilter kernel modules for IPv4 firewalling (meta-package)

config BR2_PACKAGE_KMOD_IPT_CONNTRACK
	tristate "Netfilter modules for connection tracking"
	default m
	help
	  Netfilter (IPv4) kernel modules for connection tracking

	  Includes:
	    * ipt_conntrack
	    * ipt_helper
	    * ipt_connmark/CONNMARK

config BR2_PACKAGE_KMOD_IPT_FILTER
	tristate "Netfilter modules for packet content inspection"
	default m
	help
	  Netfilter (IPv4) kernel modules for packet content inspection

	  Includes:
	    * ipt_ipp2p
	    * ipt_layer7

config BR2_PACKAGE_KMOD_IPT_IPOPT
	tristate "Netfilter modules for matching/changing IP packet options"
	default m
	help
	  Netfilter (IPv4) kernel modules for matching/changing IP packet options
	  
	  Includes:
	    * ipt_dscp/DSCP
	    * ipt_ecn/ECN
	    * ipt_length
	    * ipt_mac
	    * ipt_tos/TOS
	    * ipt_tcpmms
	    * ipt_ttl/TTL
	    * ipt_unclean

config BR2_PACKAGE_KMOD_IPT_IPSEC
	tristate "Netfilter modules for matching IPsec packets"
	default m
	help
	  Netfilter (IPv4) kernel modules for matching IPsec packets
	  
	  Includes:
	    * ipt_ah
	    * ipt_esp

config BR2_PACKAGE_KMOD_IPT_NAT
	tristate "Netfilter modules for different NAT targets"
	default m
	help
	  Netfilter (IPv4) kernel modules for different NAT targets

	  Includes: 
	    * ipt_REDIRECT

config BR2_PACKAGE_KMOD_IPT_NAT_EXTRA
	tristate "Extra Netfilter NAT modules for special protocols"
	default m
	help
	  Extra Netfilter (IPv4) NAT kernel modules for special protocols
	  
	  Includes:
	    * ip_conntrack_amanda
	    * ip_conntrack_proto_gre
	    * ip_nat_proto_gre
	    * ip_conntrack_pptp
	    * ip_nat_pptp
	    * ip_nat_snmp_basic
	    * ip_conntrack_tftp

config BR2_PACKAGE_KMOD_IPT_QUEUE
	tristate "Netfilter module for user-space packet queueing"
	default m
	help
	  Netfilter (IPv4) module for user-space packet queueing
	  
	  Includes:
	    * ipt_QUEUE

config BR2_PACKAGE_KMOD_IPT_ULOG
	tristate "Netfilter module for user-space packet logging"
	default m
	help
	  Netfilter (IPv4) module for user-space packet logging
	  
	  Includes:
	    * ipt_ULOG

config BR2_PACKAGE_KMOD_IPT_EXTRA
	tristate "Other extra Netfilter modules"
	default m
	help
	  Other extra Netfilter (IPv4) kernel modules

	  Includes:
	    * ipt_limit
	    * ipt_owner
	    * ipt_physdev
	    * ipt_pkttype
	    * ipt_recent

config BR2_PACKAGE_KMOD_IMQ
	tristate "Intermediate Queueing device"
	default m
	help
	  Kernel support for the Intermediate Queueing device

config BR2_PACKAGE_KMOD_IPV6
	tristate "IPv6 support"
	default m
	help
	  Kernel modules for IPv6 protocol support
	  
config BR2_PACKAGE_KMOD_IP6TABLES
	tristate "Kernel modules for ip6tables"
	default m
	depends BR2_PACKAGE_KMOD_IPV6
	help
	  IPv6 firewalling support

config BR2_PACKAGE_KMOD_NFS
	tristate "NFS support"
	default m
	help
	  Kernel modules for NFS support
	  Includes lockd, nfs and sunrpc

config BR2_PACKAGE_KMOD_CIFS
	tristate "CIFS support"
	default m
	help
	  Kernel modules for CIFS support

config BR2_PACKAGE_KMOD_USB
	tristate "USB support"
	default m

config BR2_PACKAGE_KMOD_USB_CONTROLLER
	tristate
	depends on BR2_PACKAGE_KMOD_USB_UHCI || BR2_PACKAGE_KMOD_USB_OHCI || BR2_PACKAGE_KMOD_USB2
	default n

config BR2_PACKAGE_KMOD_USB_UHCI
	tristate "Support for UHCI controllers"
	default m
	depends BR2_PACKAGE_KMOD_USB
	select BR2_PACKAGE_KMOD_USB_CONTROLLER

config BR2_PACKAGE_KMOD_USB_OHCI
	tristate "Support for OHCI controllers"
	default m
	depends BR2_PACKAGE_KMOD_USB
	select BR2_PACKAGE_KMOD_USB_CONTROLLER

config BR2_PACKAGE_KMOD_USB2
	tristate "Support for USB 2.0 controllers"
	default m
	depends BR2_PACKAGE_KMOD_USB
	select BR2_PACKAGE_KMOD_USB_CONTROLLER

config BR2_PACKAGE_KMOD_USB_SERIAL
        tristate "Support for serial USB devices" 
	default m 
	depends BR2_PACKAGE_KMOD_USB_CONTROLLER

config BR2_PACKAGE_KMOD_USB_SERIAL_BELKIN
	tristate "Support for Belkin USB-to-serial converters"
	default m
	depends BR2_PACKAGE_KMOD_USB_SERIAL
	
config BR2_PACKAGE_KMOD_USB_SERIAL_FTDI
	tristate "Support for FTDI USB-to-serial converterr"
	default m
	depends BR2_PACKAGE_KMOD_USB_SERIAL

config BR2_PACKAGE_KMOD_USB_SERIAL_MCT_U232
        tristate "Support for Magic Control Technology USB-to-Serial converters"
	default m
	depends BR2_PACKAGE_KMOD_USB_SERIAL

config BR2_PACKAGE_KMOD_USB_SERIAL_PL2303
	tristate "Support for Prolific PL2303 USB-to-Serial converters"
	default m
	depends BR2_PACKAGE_KMOD_USB_SERIAL
	
config BR2_PACKAGE_KMOD_USB_SERIAL_VISOR
	tristate "Support for Handspring Visor / Palm m50x / Sony Clie Driver"
	default m
	depends BR2_PACKAGE_KMOD_USB_SERIAL

config BR2_PACKAGE_KMOD_USB_STORAGE
	tristate "Support for USB storage devices"
	default m
	depends BR2_PACKAGE_KMOD_USB_CONTROLLER

config BR2_PACKAGE_KMOD_USB_PRINTER
	tristate "Support for USB printers"
	default m
	depends BR2_PACKAGE_KMOD_USB_CONTROLLER

config BR2_PACKAGE_KMOD_USB_ACM
	tristate "Support for USB ACM compatible devices"
	default m
	depends BR2_PACKAGE_KMOD_USB_CONTROLLER

config BR2_PACKAGE_KMOD_IDE
	tristate "IDE support"
	default m
	help
	  Kernel modules for IDE support
	  useful for usb mass storage devices (e.g. on WL-HDD)

config BR2_PACKAGE_KMOD_VFAT
	tristate "VFAT filesystem support"
	default m
	help
	  Kernel modules for VFAT filesystem support
	  useful for usb mass storage devices

config BR2_PACKAGE_KMOD_MINIX
	tristate "MINIX filesystem support"
	default m
	help
	  Kernel modules for MINIX filesystem support

config BR2_PACKAGE_KMOD_EXT2
	tristate "EXT2 filesystem support"
	default m
	help
	  Kernel modules for EXT2 filesystem support

config BR2_PACKAGE_KMOD_EXT3
	tristate "EXT3 filesystem support"
	default m
	help
	  Kernel modules for EXT3 filesystem support

config BR2_PACKAGE_KMOD_XFS
	tristate "XFS filesystem support"
	default m
	help
	  Kernel modules for XFS filesystem support

config BR2_PACKAGE_KMOD_HFSPLUS
	tristate "HFS+ filesystem support"
	default m
	help
	  Kernel modules for HFS+ filesystem support

config BR2_PACKAGE_KMOD_LOOP
	tristate "loop mount support"
	default m
	help
	  Kernel module for loop mount support

config BR2_PACKAGE_KMOD_NBD
	tristate "network block device"
	default m
	help
	  Kernel module for network block device

config BR2_PACKAGE_KMOD_LP
	tristate "parallel port and lp support"
	default m
	help
	  Kernel modules for line printer and parallel port support

config BR2_PACKAGE_KMOD_CRYPTO
	tristate "CryptoAPI modules"
	default m
	select BUSYBOX_CONFIG_FEATURE_CHECK_TAINTED_MODULE
	help
	  Kernel modules for cryptographic algorithms

config BR2_PACKAGE_KMOD_PPP
	tristate "PPP support"
	default m
	help
	  Kernel support for PPP

config BR2_PACKAGE_KMOD_MPPE
	tristate "PPP MPPE/MPPC module"
	default m
	select BR2_PACKAGE_KMOD_CRYPTO
	depends BR2_PACKAGE_KMOD_PPP
	help
	  Support for Microsoft PPP Encryption/Compression

config BR2_PACKAGE_KMOD_PPPOE
	tristate "PPPoE modules"
	default m
	depends BR2_PACKAGE_KMOD_PPP
	help
	  Support for PPP over Ethernet

config BR2_PACKAGE_KMOD_TUN
	tristate "Universal TUN/TAP driver"
	default m
	help
	  Kernel support for the TUN/TAP tunneling device

config BR2_PACKAGE_KMOD_GRE
	tristate "GRE tunneling driver"
	default m
	help
	  Kernel support for GRE tunnels

config BR2_PACKAGE_KMOD_SCHED
	tristate "Traffic schedulers"
	default m
	help
	  Kernel schedulers for IP traffic

config BR2_PACKAGE_KMOD_VIDEODEV
	tristate "Video (For Linux) kernel support"
	default m

config BR2_PACKAGE_KMOD_PWC
	tristate "Kernel driver for USB Philips Cameras"
	default m

config BR2_PACKAGE_KMOD_SOFTDOG
	tristate "Kernel driver for software watchdog"
	default m
	help
	  Kernel modules for software watchdog driver

config BR2_PACKAGE_KMOD_BONDING
	tristate "Kernel driver for ethernet bonding"
	default m
	help
	  Kernel modules for ethernet bonding


source "target/linux/package/Config.in"
```

## branches/whiterussian/openwrt/target/linux/package/diag/Config.in
```kconfig
config BR2_PACKAGE_KMOD_DIAG
	prompt "kmod-diag - kernel driver for LEDs and buttons"
	tristate
	default y 
	help
	  Kernel driver for LEDs and buttons.
	  
	  http://www.openwrt.org
	  
```

## branches/whiterussian/openwrt/target/linux/package/mini_fo/Config.in
```kconfig
config BR2_PACKAGE_KMOD_MINI_FO
	prompt "kmod-mini_fo - mini fanout overlay file system"
	tristate
	default m
	help
	  The mini fanout overlay file system.
```

## feeds/efl/enlightenment/Config.in
```kconfig
choice
	prompt "default enlightenment profile"
	default E17_standard

config E17_illume
	bool
	prompt "illume"

config E17_minimalist
	bool
	prompt "minimalist"

config E17_netbook
	bool
	prompt "netbook"

config E17_scalable
	bool
	prompt "scalable"

config E17_standard
	bool
	prompt "standard"

endchoice
```

## packages/Xorg/app/enlightenment/Config.in
```kconfig
choice
	prompt "default enlightenment profile"
	default E17_STANDARD

config E17_ILLUME
	bool
	prompt "illume"

config E17_MINIMALIST
	bool
	prompt "minimalist"

config E17_NETBOOK
	bool
	prompt "netbook"

config E17_SCALEABLE
	bool
	prompt "scalable"

config E17_STANDARD
	bool
	prompt "standard"

endchoice
```

## packages/Xorg/lib/qt4/Config.in
```kconfig
if PACKAGE_qt4-gui

choice
	prompt "qt4 window system"
	default QT4_WS_QWS

config QT4_WS_QWS
	bool "QWS window system"
	depends on FEATURE_drawing-backend_DirectFB
	help
	  Use QT4's internal QWS window system.

config QT4_WS_X11
	bool "X11 window system"
	depends on FEATURE_drawing-backend_libX11
	help
	  Use X11

endchoice

endif
```

## packages/Xorg/xserver/xorg-xserver/Config.in
```kconfig
menu "kdrive library support --->"
depends on PACKAGE_xserver-kdrive-xvesa || PACKAGE_xserver-kdrive-xfbdev

	config X_TSLIB
		bool
		prompt "enable support for tslib"
		depends PACKAGE_xserver-kdrive-xvesa || PACKAGE_xserver-kdrive-xfbdev

#	config X_XCALIBRATE
#		bool
#		prompt "enable support for xcalibrate"
#		depends PACKAGE_xserver-kdrive-xvesa || PACKAGE_xserver-kdrive-xfbdev

#	config X_DRI
#		bool
#		prompt "enable support for DRI"
#		depends PACKAGE_xserver-kdrive-xvesa || PACKAGE_xserver-kdrive-xfbdev

	config X_COMPOSITE
		bool
		prompt "enable support for composite"
		depends PACKAGE_xserver-kdrive-xvesa || PACKAGE_xserver-kdrive-xfbdev

	config X_XINERAMA
		bool
		prompt "enable support for xinerama"
		depends PACKAGE_xserver-kdrive-xvesa || PACKAGE_xserver-kdrive-xfbdev

#	config X_GLX
#		bool
#		prompt "enable support for GLX"
#		depends PACKAGE_xserver-kdrive-xvesa || PACKAGE_xserver-kdrive-xfbdev

endmenu
```

## packages/libs/clearsilver/Config.in
```kconfig
config CLEARSILVER_ENABLE_COMPRESSION
     bool "HTML compression support" if PACKAGE_clearsilver
     default y if CONFIG_PACKAGE_zlib

config CLEARSILVER_ENABLE_REMOTE_DEBUGGER
     bool "Remote X CGI debugging" if PACKAGE_clearsilver
     default n

config CLEARSILVER_ENABLE_GETTEXT
     bool "Gettext message translation" if PACKAGE_clearsilver
     default n
```
