## tags/whiterussian_0.9/package/openvpn/Config.in
```kconfig
config BR2_PACKAGE_OPENVPN
	tristate "openvpn - Open source VPN solution using SSL"
	default m if CONFIG_DEVEL
	select BR2_PACKAGE_KMOD_TUN
	select BR2_PACKAGE_LIBOPENSSL
	help
	  Open Source VPN solution using SSL
	  
	  http://openvpn.net/
	  
	  Depends: kmod-tun, libpthread, openssl

config BR2_PACKAGE_OPENVPN_EASY_RSA
	tristate "openvpn-easy-rsa - simple shell scripts to manage a Certificate Authority"
	default m
	depends BR2_PACKAGE_OPENVPN
	select BR2_PACKAGE_OPENSSL_UTIL

config BR2_PACKAGE_OPENVPN_WEBIF
	tristate "openvpn-webif - web interface module to configure OpenVPN (client mode)"
	default m
	depends BR2_PACKAGE_OPENVPN
	select BR2_PACKAGE_WEBIF
	help
	  Web interface module to configure and report status of OpenVPN (client
	  mode only)

config BR2_PACKAGE_OPENVPN_SERVER
	bool "Enable server support"
	default y
	depends BR2_PACKAGE_OPENVPN

config BR2_PACKAGE_OPENVPN_HTTP
	bool "Enable http proxy support"
	default y
	depends BR2_PACKAGE_OPENVPN

config BR2_PACKAGE_OPENVPN_OPENSSL
	bool "Enable openssl support"
	default y
	depends BR2_PACKAGE_OPENVPN
	select BR2_PACKAGE_LIBOPENSSL

config BR2_PACKAGE_OPENVPN_LZO
	bool "Enable transparent compression (lzo)"
	default y
	depends BR2_PACKAGE_OPENVPN
	select BR2_PACKAGE_LIBLZO

config BR2_PACKAGE_OPENVPN_PASSWORD_SAVE
	bool "Enable password saving"
	default y
	depends BR2_PACKAGE_OPENVPN

config BR2_PACKAGE_OPENVPN_MANAGEMENT
	bool "Enable PKCS12 management features"
	default n
	depends BR2_PACKAGE_OPENVPN

config BR2_PACKAGE_OPENVPN_SMALL
	bool "Enable smaller executable size (disable OCC, usage message, and verb 4 parm list)"
	default n
	depends BR2_PACKAGE_OPENVPN
```

## tags/whiterussian_0.9/package/procps/Config.in
```kconfig
menu "Basic /proc utilities"

config BR2_PACKAGE_PROCPS
	prompt "Basic /proc utilities"
	tristate
	default m if CONFIG_DEVEL
	help
	procps is a package that has many small useful utilities that 
	give information about processes using the /proc filesystem. The 
	package includes the programs ps, vmstat, top, w, kill, free, slabtop, 
	skill, and others.

	Note that versions of many of these programs are included in BusyBox.
	This package will replace many of them.

	http://procps.sourceforge.net/

config BR2_PACKAGE_PROCPS_PS
	prompt "ps - report a snapshot of the current processes."
	bool
	default y if CONFIG_DEVEL
	depends BR2_PACKAGE_PROCPS

config BR2_PACKAGE_PROCPS_VMSTAT
	prompt "vmstat - Report virtual memory statistics"
	bool
	default y if CONFIG_DEVEL
	depends BR2_PACKAGE_PROCPS

config BR2_PACKAGE_PROCPS_TOP
	prompt "top (requires libncurses) - display Linux tasks"
	bool
	default y if CONFIG_DEVEL
	depends BR2_PACKAGE_PROCPS
	select BR2_PACKAGE_LIBNCURSES

config BR2_PACKAGE_PROCPS_SLABTOP
        prompt "slabtop (requires libncurses) - display kernel slab cache info"
        bool
        default y if CONFIG_DEVEL
        depends BR2_PACKAGE_PROCPS
	select BR2_PACKAGE_LIBNCURSES

config BR2_PACKAGE_PROCPS_PMAP
        prompt "pmap - report memory map of a process"
        bool
        default y if CONFIG_DEVEL
        depends BR2_PACKAGE_PROCPS

config BR2_PACKAGE_PROCPS_PWDX
        prompt "pwdx - report current working directory of a process"
        bool
        default y if CONFIG_DEVEL
        depends BR2_PACKAGE_PROCPS

config BR2_PACKAGE_PROCPS_W
	prompt "w - Show who is logged on and what they are doing"
	bool
	default y if CONFIG_DEVEL
	depends BR2_PACKAGE_PROCPS

config BR2_PACKAGE_PROCPS_KILL
        prompt "kill - terminate a process"
        bool
        default y if CONFIG_DEVEL
        depends BR2_PACKAGE_PROCPS

config BR2_PACKAGE_PROCPS_SKILL
        prompt "skill, snice - send a signal or report process status"
        bool
        default y if CONFIG_DEVEL
        depends BR2_PACKAGE_PROCPS

config BR2_PACKAGE_PROCPS_PGREP
	prompt "pgrep, pkill - lookup or signal processes based on name or other attributes"
	bool
	default y if CONFIG_DEVEL
	depends BR2_PACKAGE_PROCPS

config BR2_PACKAGE_PROCPS_FREE
        prompt "free - display system memory information"
        bool
        default y if CONFIG_DEVEL
        depends BR2_PACKAGE_PROCPS

config BR2_PACKAGE_PROCPS_SYSCTL
        prompt "sysctl - configure kernel parameters at runtime"
        bool
        default y if CONFIG_DEVEL
        depends BR2_PACKAGE_PROCPS

config BR2_PACKAGE_PROCPS_TLOAD
	prompt "tload - graphic representation of system load average"
	bool
	default y if CONFIG_DEVEL
	depends BR2_PACKAGE_PROCPS

config BR2_PACKAGE_PROCPS_WATCH
	prompt "watch - execute a program periodically with fullscreen output"
	bool
	default y if CONFIG_DEVEL
	depends BR2_PACKAGE_PROCPS

endmenu
```

## tags/whiterussian_0.9/target/linux/package/switch/Config.in
```kconfig
config BR2_PACKAGE_KMOD_SWITCH
	prompt "kmod-switch - kernel driver for ROBO and ADMTEK SWITCH"
	tristate
	default y 
	help
	  Kernel driver for ROBO and ADMTEK switches.
	  
	  http://www.openwrt.org
	  
```

## tags/whiterussian_rc5/openwrt/package/ipkg/Config.in
```kconfig
config BR2_PACKAGE_IPKG
	tristate
	default n
	depends BR2_PACKAGE_IPKG_C || BR2_PACKAGE_IPKG_SHELL

config BR2_PACKAGE_IPKG_C
	tristate "ipkg - itsy package management system"
	default y
	select BR2_PACKAGE_IPKG
	help
	 Lightweight package management system
	 ipkg is the Itsy Package Management System, for handling
	 installation and removal of packages on a system. It can
	 recursively follow dependencies and download all packages
	 necessary to install a particular package.
	 
	 ipkg knows how to install both .ipk and .deb packages.

	 ipkg is intended to serve the same functions (and more) for
	 Familiar that dpkg and apt serve for Debian, (while taking
	 up much less space).
	 
config BR2_PACKAGE_IPKG_SH
	tristate "ipkg - itsy package management system (shell version)"
	default m if CONFIG_DEVEL
	select BR2_PACKAGE_IPKG
	help
	 Lightweight package management system
	 ipkg is the Itsy Package Management System, for handling
	 installation and removal of packages on a system. It can
	 recursively follow dependencies and download all packages
	 necessary to install a particular package.
	 
	 ipkg knows how to install both .ipk and .deb packages.

	 ipkg is intended to serve the same functions (and more) for
	 Familiar that dpkg and apt serve for Debian, (while taking
	 up much less space).
```

## tags/whiterussian_rc6/package/comgt/Config.in
```kconfig
config BR2_PACKAGE_COMGT
	tristate "comgt - Option/Vodafone 3G/GPRS control tool"
	default m if CONFIG_DEVEL
	select BR2_PACKAGE_CHAT
	help
	  Option GlobeTrotter GPRS/EDGE/3G/HSDPA and Vodafone 3G/GPRS datacard control tool
	  
	  comgt is a scripting language interpreter useful for establishing communications
	  on serial lines and through PCMCIA modems as well as GPRS and 3G datacards.
	  
	  http://www.pharscape.org/content/view/46/70/

	  This package contains the scripts for setting up 3G/UMTS/GPRS
```

## tags/whiterussian_rc6/package/haserl/Config.in
```kconfig
config BR2_PACKAGE_HASERL
	tristate "haserl - CGI wrapper to embed shell scripts in HTML documents"
	default y
	help
	  A CGI wrapper to embed shell scripts in HTML documents.
	  
	  http://haserl.sourceforge.net/
	  
```

## tags/whiterussian_rc6/package/iptables/Config.in
```kconfig
config BR2_PACKAGE_IPTABLES
	tristate "iptables - IPv4 firewall administration tool"
	default y
	help
	  Linux kernel (2.4+) firewall, NAT, and packet mangling tools.
	  
	  http://www.iptables.org/

config BR2_PACKAGE_IPTABLES_EXTRA
	tristate "iptables-extra - Extra Iptables extensions for IPv4 firewalling (meta-package)"
	default m if CONFIG_DEVEL
	depends BR2_PACKAGE_IPTABLES
	select BR2_PACKAGE_KMOD_IPT_EXTRA
	select BR2_PACKAGE_IPTABLES_MOD_CONNTRACK
	select BR2_PACKAGE_IPTABLES_MOD_EXTRA
	select BR2_PACKAGE_IPTABLES_MOD_FILTER
	select BR2_PACKAGE_IPTABLES_MOD_IMQ
	select BR2_PACKAGE_IPTABLES_MOD_IPOPT
	select BR2_PACKAGE_IPTABLES_MOD_IPSEC
	select BR2_PACKAGE_IPTABLES_MOD_NAT
	select BR2_PACKAGE_IPTABLES_MOD_ULOG
	help
	  Extra Iptables extensions for IPv4 firewalling (meta-package)

config BR2_PACKAGE_IPTABLES_MOD_CONNTRACK
	tristate "iptables-mod-conntrack - Iptables extensions for connection tracking"
	default m if CONFIG_DEVEL
	depends BR2_PACKAGE_IPTABLES
	select BR2_PACKAGE_KMOD_IPT_CONNTRACK
	help
	  Iptables (IPv4) extensions for connection tracking

	  Includes:
            * libipt_conntrack
            * libipt_helper
            * libipt_connmark/CONNMARK
  
config BR2_PACKAGE_IPTABLES_MOD_EXTRA
	tristate "iptables-mod-extra - Other extra Iptables extensions"
	default m if CONFIG_DEVEL
	depends BR2_PACKAGE_IPTABLES
	select BR2_PACKAGE_KMOD_IPT_EXTRA
	help
	  Other extra Iptables (IPv4) extensions

	  Includes:
            * libipt_limit
            * libipt_owner
            * libipt_physdev
            * libipt_pkttype
            * libipt_recent

config BR2_PACKAGE_IPTABLES_MOD_FILTER
	tristate "iptables-mod-filter - Iptables extension for packet content inspection"
	default m if CONFIG_DEVEL
	depends BR2_PACKAGE_IPTABLES
	select BR2_PACKAGE_KMOD_IPT_FILTER
	help
	  Iptables (IPv4) extension for packet content inspection

	  Includes:
            * libipt_ipp2p
            * libipt_layer7

config BR2_PACKAGE_IPTABLES_MOD_IPOPT
	tristate "iptables-mod-ipopt - Iptables extensions for matching/changing IP packet options"
	default m if CONFIG_DEVEL
	depends BR2_PACKAGE_IPTABLES
	select BR2_PACKAGE_KMOD_IPT_IPOPT
	help
	  Extra Iptables (IPv4) extensions for matching/changing IP packet options

	  Includes:
            * libipt_dscp/DSCP
            * libipt_ecn/ECN
            * libipt_length
            * libipt_mac
            * libipt_tos/TOS
            * libipt_tcpmms
            * libipt_ttl/TTL
            * libipt_unclean

config BR2_PACKAGE_IPTABLES_MOD_IPSEC
	tristate "iptables-mod-ipsec - Iptables extensions for matching special IPsec packets"
	default m if CONFIG_DEVEL
	depends BR2_PACKAGE_IPTABLES
	select BR2_PACKAGE_KMOD_IPT_IPSEC
	help
	  Iptables (IPv4) extensions for matching special IPsec packets

	  Includes:
            * libipt_ah
            * libipt_esp

config BR2_PACKAGE_IPTABLES_MOD_NAT
	tristate "iptables-mod-nat - Iptables extensions for different NAT targets"
	default m if CONFIG_DEVEL
	depends BR2_PACKAGE_IPTABLES
	select BR2_PACKAGE_KMOD_IPT_NAT
	help
	  Iptables (IPv4) extensions for different NAT targets

	  Includes:
	    * libipt_REDIRECT

config BR2_PACKAGE_IPTABLES_MOD_IMQ
       tristate "iptables-mod-imq - Iptables extensions for Intermediate Queuing Device QoS-support"
       default m if CONFIG_DEVEL
       depends BR2_PACKAGE_IPTABLES
       select BR2_PACKAGE_KMOD_IMQ
       help
         Iptables (IPv4) extensions for Intermediate Queuing Device QoS-support

config BR2_PACKAGE_IPTABLES_MOD_ULOG
	tristate "iptables-mod-ulog - Iptables extensions for user-space packet logging"
	default m if CONFIG_DEVEL
	depends BR2_PACKAGE_IPTABLES
	select BR2_PACKAGE_KMOD_IPT_ULOG
	help
	  Iptables (IPv4) extensions for user-space packet logging
	  
	  Includes:
	  * libipt_ULOG

config BR2_PACKAGE_IPTABLES_UTILS
	tristate "iptables-utils - Save and restore utilities"
	default m if CONFIG_DEVEL
	depends BR2_PACKAGE_IPTABLES
	help
	  iptables-save and iptables-restore for Iptables (IPv4)

config BR2_PACKAGE_IP6TABLES
	tristate "ip6tables - IPv6 firewall administration tool"
	default m if CONFIG_DEVEL
	depends BR2_PACKAGE_IPTABLES
	select BR2_PACKAGE_KMOD_IPV6
	help
	  IPv6 firewalling
```

## tags/whiterussian_rc6/package/wireless-tools/Config.in
```kconfig
config BR2_COMPILE_WIRELESS_TOOLS
	tristate
	default n
	depends BR2_PACKAGE_IWLIB

config BR2_PACKAGE_WIRELESS_TOOLS
	tristate "wireless-tools - Tools for manipulating Linux Wireless Extensions"
	default y
	select BR2_PACKAGE_IWLIB
	help
	  Tools for configuring Wireless Adapters implementing the "Wireless Extension"

config BR2_PACKAGE_IWLIB
	tristate "iwlib - Library for manipulating Linux Wireless Extensions"
	default y
	select BR2_COMPILE_WIRELESS_TOOLS
	help
	  Library configuring Wireless Adapters implementing the "Wireless Extension"
```

## tags/whiterussian_rc6/target/linux/package/nozomi/Config.in
```kconfig
config BR2_PACKAGE_KMOD_NOZOMI
	prompt "kmod-nozomi - Option Globetrotter HSDPA driver"
	tristate
	default m
	help
	  Kernel driver for Option Globetrotter HSDPA 3G card.
	  
	  http://www.pharscape.org/
```

## trunk/package/boot/uboot-linino/Config.in
```kconfig
if PACKAGE_uboot-ar71xx-Linino
	
config COMPRESSED_UBOOT
	bool
	prompt "Enable compressed uboot"
	depends on PACKAGE_uboot-ar71xx-Linino
	default y	
config HORNET_1_1_WAR
	bool 
	prompt "Enable Hornet war"
	depends on PACKAGE_uboot-ar71xx-Linino
	default y

config NEW_DDR_TAP_CAL
	bool 
	prompt "Enable new ddr tap"
	depends on PACKAGE_uboot-ar71xx-Linino
	default y

config LININO_DDR2
	bool 
	prompt "Memory is DDR2"
	depends on PACKAGE_uboot-ar71xx-Linino
	default y
endif
```
