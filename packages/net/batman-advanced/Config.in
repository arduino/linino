## packages/net/batman-advanced/Config.in
```kconfig
choice
	prompt "branch"
	depends PACKAGE_kmod-batman-adv-kernelland
	default BATMAN_ADV_MAINTENANCE
	help
	  This option allows you to select the version of B.A.T.M.A.N.-Advanced.

config BATMAN_ADV_MAINTENANCE
	bool "maintenance"
	help
	  This version contains the latest release version plus some additional
	  bug fixes cherrypicked from the batman-adv trunk.

	  If unsure, select this.

config BATMAN_ADV_DEV
	bool "development"
	help
	  This version contains a version from batman-adv's trunk which offers
	  new, but not that well tested, features.

	  If unsure, select "maintenance".
endchoice

config KMOD_BATMAN_ADV_DEBUG_LOG
	bool "enable verbose debug logging"
	depends PACKAGE_kmod-batman-adv-kernelland
	default n
config KMOD_BATMAN_ADV_BATCTL
	bool "enable batctl"
	depends PACKAGE_kmod-batman-adv-kernelland
	default y
	help
	  batctl is a more intuitive managment utility for B.A.T.M.A.N.-Advanced.
	  It is an easier method for configuring batman-adv and
	  provides some additional tools for debugging as well.
```

## packages/net/dhcp4/Config.in
```kconfig
config DHCP4_ENABLE_IPV6
	bool "Enable IPv6 capabilities (DHCPv6)"
	depends on PACKAGE_kmod-ipv6 && PACKAGE_dhcp4
	default y
	help
	  Enables IPv6 features in all built DHCP4 packages
```

## packages/net/nginx/Config.in
```kconfig
#
# Copyright (C) 2010-2012 OpenWrt.org
#
# This is free software, licensed under the GNU General Public License v2.
# See /LICENSE for more information.
#

menu "Configuration"
        depends on PACKAGE_nginx

config NGINX_STUB_STATUS
	bool
	prompt "Enable stub status module"
	default n
	help
		Enable the stub status module which gives some status from the server.

config NGINX_FLV
	bool
	prompt "Enable FLV module"
	default n
	help
		Provides the ability to seek within FLV (Flash) files using time-based offsets.

config NGINX_SSL
	bool
	prompt "Enable SSL module"
	default n
	help
		Enable HTTPS/SSL support.

config NGINX_DAV
	bool
	prompt "Enable WebDAV module"
	default n
	help
		Enable the HTTP and WebDAV methods PUT, DELETE, MKCOL, COPY and MOVE.

config NGINX_MODULE_LUA
	bool
	prompt "Enable LUA module"
	default n
	help
		Enable support for LUA scripts.

	menu "Disable features"

	config NGINX_DISABLE_PCRE
	      bool
	      prompt "Disable PCRE library usage"
	      default n

	config NGINX_DISABLE_HTTP_CACHE
	      depends on NGINX_SSL=y
	      bool
	      prompt "Disable HTTP cache"
	      default y

	config NGINX_DISABLE_HTTP_CHARSET_MODULE
	      bool
	      prompt "Disable HTTP charset module"
	      default n

	config NGINX_DISABLE_HTTP_GZIP_MODULE
	      bool
	      prompt "Disable HTTP gzip module"
	      default n

	config NGINX_DISABLE_HTTP_SSI_MODULE
	      bool
	      prompt "Disable HTTP ssi module"
	      default n

	config NGINX_DISABLE_HTTP_USERID_MODULE
	      bool
	      prompt "Disable HTTP userid module"
	      default n

	config NGINX_DISABLE_HTTP_ACCESS_MODULE
	      bool
	      prompt "Disable HTTP access module"
	      default n

	config NGINX_DISABLE_HTTP_AUTH_BASIC_MODULE
	      bool
	      prompt "Disable HTTP auth basic"
	      default n

	config NGINX_DISABLE_HTTP_AUTOINDEX_MODULE
	      bool
	      prompt "Disable HTTP autoindex module"
	      default n

	config NGINX_DISABLE_HTTP_GEO_MODULE
	      bool
	      prompt "Disable HTTP geo module"
	      default n

	config NGINX_DISABLE_HTTP_MAP_MODULE
	      bool
	      prompt "Disable HTTP map module"
	      default n

	config NGINX_DISABLE_HTTP_SPLIT_CLIENTS_MODULE
	      bool
	      prompt "Disable HTTP split clients"
	      default n

	config NGINX_DISABLE_HTTP_REFERER_MODULE
	      bool
	      prompt "Disable HTTP referer module"
	      default n

	config NGINX_DISABLE_HTTP_REWRITE_MODULE
	      bool
	      prompt "Disable HTTP rewrite module"
	      default n

	config NGINX_DISABLE_HTTP_PROXY_MODULE
	      bool
	      prompt "Disable HTTP proxy module"
	      default n

	config NGINX_DISABLE_HTTP_FASTCGI_MODULE
	      bool
	      prompt "Disable HTTP fastcgi module"
	      default n

	config NGINX_DISABLE_HTTP_UWSGI_MODULE
	      bool
	      prompt "Disable HTTP uwsgi module"
	      default n

	config NGINX_DISABLE_HTTP_SCGI_MODULE
	      bool
	      prompt "Disable HTTP scgi module"
	      default n

	config NGINX_DISABLE_HTTP_MEMCACHED_MODULE
	      bool
	      prompt "Disable HTTP memcached module"
	      default n

	config NGINX_DISABLE_HTTP_LIMIT_CONN_MODULE
	      bool
	      prompt "Disable HTTP limit conn"
	      default n

	config NGINX_DISABLE_HTTP_LIMIT_REQ_MODULE
	      bool
	      prompt "Disable HTTP limit req"
	      default n

	config NGINX_DISABLE_HTTP_EMPTY_GIF_MODULE
	      bool
	      prompt "Disable HTTP empty gif"
	      default n

	config NGINX_DISABLE_HTTP_BROWSER_MODULE
	      bool
	      prompt "Disable HTTP browser module"
	      default n

	config NGINX_DISABLE_HTTP_UPSTREAM_IP_HASH_MODULE
	      bool
	      prompt "Disable HTTP IP hash module"
	      default n

	endmenu
endmenu
```

## packages/net/openvpn/Config.in
```kconfig
menu "Configuration"
	depends on PACKAGE_openvpn

config OPENVPN_LZO
	bool "Disable LZO compression support"
	depends on PACKAGE_openvpn
	default n

config OPENVPN_CRYPTO
	bool "Disable OpenSSL crypto support"
	depends on PACKAGE_openvpn
	default n

config OPENVPN_SSL
	bool "Disable OpenSSL SSL support for TLS-based key exchange"
	depends on PACKAGE_openvpn
	default n

config OPENVPN_X509_ALT_USERNAME
	bool "Enable the --x509-username-field feature"
	depends on PACKAGE_openvpn
	default n

config OPENVPN_MULTI
	bool "Disable client/server support (--mode server + client mode)"
	depends on PACKAGE_openvpn
	default n

config OPENVPN_SERVER
	bool "Disable server support only (but retain client support)"
	depends on PACKAGE_openvpn
	default n

config OPENVPN_EUREPHIA
	bool "Disable support for the eurephia plug-in"
	depends on PACKAGE_openvpn
	default y

config OPENVPN_MANAGEMENT
	bool "Disable management server support"
	depends on PACKAGE_openvpn
	default y

config OPENVPN_PKCS11
	bool "Disable pkcs11 support"
	depends on PACKAGE_openvpn
	default n

config OPENVPN_HTTP
	bool "Disable HTTP proxy support"
	depends on PACKAGE_openvpn
	default n

config OPENVPN_FRAGMENT
	bool "Disable internal fragmentation support (--fragment)"
	depends on PACKAGE_openvpn
	default n

config OPENVPN_MULTIHOME
	bool "Disable multi-homed UDP server support (--multihome)"
	depends on PACKAGE_openvpn
	default n

config OPENVPN_PORT_SHARE
	bool "Disable TCP server port-share support (--port-share)"
	depends on PACKAGE_openvpn
	default n

config OPENVPN_ENABLE_PASSWORD_SAVE
	bool "Allow --askpass and --auth-user-pass passwords to be read from a file"
	depends on PACKAGE_openvpn
	default n

config OPENVPN_DEF_AUTH
	bool "Disable deferred authentication"
	depends on PACKAGE_openvpn
	default n

config OPENVPN_PF
	bool "Disable internal packet filter"
	depends on PACKAGE_openvpn
	default n

endmenu
```

## packages/net/wing/Config.in
```kconfig
# Wing configuration

choice
	prompt "Version"
	depends on PACKAGE_wing
	default WING_STABLE
	help
		This option allows you to select the version of Wing to be built.

config WING_STABLE
	bool "Use the stable version (multi-interface)"

config WING_TESTING
	bool "Use the unstable version (multi-interfaces w/ ITACA)"

endchoice
```
