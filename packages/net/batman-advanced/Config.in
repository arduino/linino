## packages/utils/lcd4linux/Config.in
```kconfig
config LCD4LINUX_HAS_AT_LEAST_ONE_DRIVER
	bool

config LCD4LINUX_HAS_AT_LEAST_ONE_PLUGIN
	bool

config LCD4LINUX_NEEDS_libdbus
	bool
	select PACKAGE_libdbus

#config LCD4LINUX_NEEDS_libftdi
#	bool
#	select PACKAGE_libftdi

config LCD4LINUX_NEEDS_libgd
	bool
	select PACKAGE_libgd
	default y if !LCD4LINUX_HAS_AT_LEAST_ONE_DRIVER

config LCD4LINUX_NEEDS_libiconv
	bool
	select PACKAGE_libiconv

config LCD4LINUX_NEEDS_libmysqlclient
	bool
	select PACKAGE_libmysqlclient

config LCD4LINUX_NEEDS_libncurses
	bool
	select PACKAGE_libncurses

config LCD4LINUX_NEEDS_libnmeap
	bool
	select PACKAGE_libnmeap

config LCD4LINUX_NEEDS_libsqlite3
	bool
	select PACKAGE_libsqlite3

config LCD4LINUX_NEEDS_libusb
	bool
	select PACKAGE_libusb

config LCD4LINUX_NEEDS_libvncserver
	bool
	select PACKAGE_libvncserver

#config LCD4LINUX_NEEDS_libX11
#	bool
#	select PACKAGE_libX11

config LCD4LINUX_NEEDS_ppp
	bool
	select PACKAGE_ppp

config LCD4LINUX_NEEDS_python
	bool
	select PACKAGE_python

config LCD4LINUX_NEEDS_serdisplib
	bool
	select PACKAGE_serdisplib

config LCD4LINUX_NEEDS_st2205tool
	bool
	select PACKAGE_st2205tool


comment "LCD4Linux Drivers ---"

comment "WARNING: no drivers selected, the 'Sample' driver will be used !!!"
	depends !LCD4LINUX_HAS_AT_LEAST_ONE_DRIVER

config LCD4LINUX_DRV_BeckmannEgle
	bool
	prompt "BeckmannEgle"
	select LCD4LINUX_HAS_AT_LEAST_ONE_DRIVER

config LCD4LINUX_DRV_BWCT
	bool
	prompt "BWCT"
	select LCD4LINUX_HAS_AT_LEAST_ONE_DRIVER
	select LCD4LINUX_NEEDS_libusb

config LCD4LINUX_DRV_CrystalFontz
	bool
	prompt "CrystalFontz"
	select LCD4LINUX_HAS_AT_LEAST_ONE_DRIVER

config LCD4LINUX_DRV_Curses
	bool
	prompt "Curses"
	select LCD4LINUX_HAS_AT_LEAST_ONE_DRIVER
	select LCD4LINUX_NEEDS_libncurses

config LCD4LINUX_DRV_Cwlinux
	bool
	prompt "Cwlinux"
	select LCD4LINUX_HAS_AT_LEAST_ONE_DRIVER

config LCD4LINUX_DRV_D4D
	bool
	prompt "D4D"
	select LCD4LINUX_HAS_AT_LEAST_ONE_DRIVER

config LCD4LINUX_DRV_EA232graphic
	bool
	prompt "EA232graphic"
	select LCD4LINUX_HAS_AT_LEAST_ONE_DRIVER
	select LCD4LINUX_NEEDS_libgd

config LCD4LINUX_DRV_G15
	bool
	prompt "G15"
	select LCD4LINUX_HAS_AT_LEAST_ONE_DRIVER
	select LCD4LINUX_NEEDS_libgd
	select LCD4LINUX_NEEDS_libusb

config LCD4LINUX_DRV_GLCD2USB
	bool
	prompt "GLCD2USB"
	select LCD4LINUX_HAS_AT_LEAST_ONE_DRIVER
	select LCD4LINUX_NEEDS_libusb

config LCD4LINUX_DRV_HD44780
	bool
	prompt "HD44780"
	select LCD4LINUX_HAS_AT_LEAST_ONE_DRIVER
	depends BROKEN

config LCD4LINUX_DRV_HD44780-I2C
	bool
	prompt "HD44780-I2C"
	select LCD4LINUX_HAS_AT_LEAST_ONE_DRIVER
	depends BROKEN

config LCD4LINUX_DRV_IRLCD
	bool
	prompt "IRLCD"
	select LCD4LINUX_HAS_AT_LEAST_ONE_DRIVER
	select LCD4LINUX_NEEDS_libusb

config LCD4LINUX_DRV_LCD2USB
	bool
	prompt "LCD2USB"
	select LCD4LINUX_HAS_AT_LEAST_ONE_DRIVER
	select LCD4LINUX_NEEDS_libusb

config LCD4LINUX_DRV_LCDLinux
	bool
	prompt "LCDLinux"
	select LCD4LINUX_HAS_AT_LEAST_ONE_DRIVER
	depends BROKEN

config LCD4LINUX_DRV_LCDTerm
	bool
	prompt "LCDTerm"
	select LCD4LINUX_HAS_AT_LEAST_ONE_DRIVER

config LCD4LINUX_DRV_LEDMatrix
	bool
	prompt "LEDMatrix"
	select LCD4LINUX_HAS_AT_LEAST_ONE_DRIVER
	select LCD4LINUX_NEEDS_libgd

config LCD4LINUX_DRV_LPH7508
	bool
	prompt "LPH7508"
	select LCD4LINUX_HAS_AT_LEAST_ONE_DRIVER
	select LCD4LINUX_NEEDS_libgd

config LCD4LINUX_DRV_LUIse
	bool
	prompt "LUIse"
	select LCD4LINUX_HAS_AT_LEAST_ONE_DRIVER
	select LCD4LINUX_NEEDS_libgd
	#select LCD4LINUX_NEEDS_libluise
	depends BROKEN

config LCD4LINUX_DRV_LW_ABP
	bool
	prompt "LW_ABP"
	select LCD4LINUX_HAS_AT_LEAST_ONE_DRIVER

config LCD4LINUX_DRV_M50530
	bool
	prompt "M50530"
	select LCD4LINUX_HAS_AT_LEAST_ONE_DRIVER

config LCD4LINUX_DRV_MatrixOrbital
	bool
	prompt "MatrixOrbital"
	select LCD4LINUX_HAS_AT_LEAST_ONE_DRIVER

config LCD4LINUX_DRV_MatrixOrbitalGX
	bool
	prompt "MatrixOrbitalGX"
	select LCD4LINUX_HAS_AT_LEAST_ONE_DRIVER
	select LCD4LINUX_NEEDS_libgd
	select LCD4LINUX_NEEDS_libusb

config LCD4LINUX_DRV_mdm166a
	bool
	prompt "mdm166a"
	select LCD4LINUX_HAS_AT_LEAST_ONE_DRIVER

config LCD4LINUX_DRV_MilfordInstruments
	bool
	prompt "MilfordInstruments"
	select LCD4LINUX_HAS_AT_LEAST_ONE_DRIVER

config LCD4LINUX_DRV_Newhaven
	bool
	prompt "Newhaven"
	select LCD4LINUX_HAS_AT_LEAST_ONE_DRIVER

config LCD4LINUX_DRV_Noritake
	bool
	prompt "Noritake"
	select LCD4LINUX_HAS_AT_LEAST_ONE_DRIVER
	select LCD4LINUX_NEEDS_libgd

config LCD4LINUX_DRV_NULL
	bool
	prompt "NULL"
	select LCD4LINUX_HAS_AT_LEAST_ONE_DRIVER
	default y

config LCD4LINUX_DRV_Pertelian
	bool
	prompt "Pertelian"
	select LCD4LINUX_HAS_AT_LEAST_ONE_DRIVER

config LCD4LINUX_DRV_PHAnderson
	bool
	prompt "PHAnderson"
	select LCD4LINUX_HAS_AT_LEAST_ONE_DRIVER

config LCD4LINUX_DRV_PICGraphic
	bool
	prompt "PICGraphic"
	select LCD4LINUX_HAS_AT_LEAST_ONE_DRIVER
	select LCD4LINUX_NEEDS_libgd

config LCD4LINUX_DRV_picoLCD
	bool
	prompt "picoLCD"
	select LCD4LINUX_HAS_AT_LEAST_ONE_DRIVER
	select LCD4LINUX_NEEDS_libusb

config LCD4LINUX_DRV_picoLCDGraphic
	bool
	prompt "picoLCDGraphic"
	select LCD4LINUX_HAS_AT_LEAST_ONE_DRIVER
	select LCD4LINUX_NEEDS_libgd
	select LCD4LINUX_NEEDS_libusb

config LCD4LINUX_DRV_PNG
	bool
	prompt "PNG"
	select LCD4LINUX_HAS_AT_LEAST_ONE_DRIVER
	select LCD4LINUX_NEEDS_libgd

config LCD4LINUX_DRV_PPM
	bool
	prompt "PPM"
	select LCD4LINUX_HAS_AT_LEAST_ONE_DRIVER
	select LCD4LINUX_NEEDS_libgd

config LCD4LINUX_DRV_RouterBoard
	bool
	prompt "RouterBoard"
	select LCD4LINUX_HAS_AT_LEAST_ONE_DRIVER
	depends on TARGET_rb532

config LCD4LINUX_DRV_serdisplib
	bool
	prompt "serdisplib"
	select LCD4LINUX_HAS_AT_LEAST_ONE_DRIVER
	select LCD4LINUX_NEEDS_libgd
	select LCD4LINUX_NEEDS_serdisplib

config LCD4LINUX_DRV_ShuttleVFD
	bool
	prompt "ShuttleVFD"
	select LCD4LINUX_HAS_AT_LEAST_ONE_DRIVER
	select LCD4LINUX_NEEDS_libusb

config LCD4LINUX_DRV_SimpleLCD
	bool
	prompt "SimpleLCD"
	select LCD4LINUX_HAS_AT_LEAST_ONE_DRIVER

config LCD4LINUX_DRV_st2205
	bool
	prompt "st2205"
	select LCD4LINUX_HAS_AT_LEAST_ONE_DRIVER
	select LCD4LINUX_NEEDS_libgd
	select LCD4LINUX_NEEDS_st2205tool

config LCD4LINUX_DRV_T6963
	bool
	prompt "T6963"
	select LCD4LINUX_HAS_AT_LEAST_ONE_DRIVER
	select LCD4LINUX_NEEDS_libgd

config LCD4LINUX_DRV_Trefon
	bool
	prompt "Trefon"
	select LCD4LINUX_HAS_AT_LEAST_ONE_DRIVER
	select LCD4LINUX_NEEDS_libusb

#config LCD4LINUX_DRV_ULA200
#	bool
#	prompt "ULA200"
#	select LCD4LINUX_HAS_AT_LEAST_ONE_DRIVER
#	select LCD4LINUX_NEEDS_libftdi
#	select LCD4LINUX_NEEDS_libusb

config LCD4LINUX_DRV_USBHUB
	bool
	prompt "USBHUB"
	select LCD4LINUX_HAS_AT_LEAST_ONE_DRIVER
	select LCD4LINUX_NEEDS_libusb

config LCD4LINUX_DRV_USBLCD
	bool
	prompt "USBLCD"
	select LCD4LINUX_HAS_AT_LEAST_ONE_DRIVER
	select LCD4LINUX_NEEDS_libusb

config LCD4LINUX_DRV_VNC
	bool
	prompt "VNC"
	select LCD4LINUX_HAS_AT_LEAST_ONE_DRIVER
	select LCD4LINUX_NEEDS_libvncserver

config LCD4LINUX_DRV_WincorNixdorf
	bool
	prompt "WincorNixdorf"
	select LCD4LINUX_HAS_AT_LEAST_ONE_DRIVER

#config LCD4LINUX_DRV_X11
#	bool
#	prompt "X11"
#	select LCD4LINUX_HAS_AT_LEAST_ONE_DRIVER
#	select LCD4LINUX_NEEDS_libgd
#	select LCD4LINUX_NEEDS_libX11


comment "LCD4Linux Plugins ---"

comment "WARNING: no plugins selected, the 'sample' plugin will be used !!!"
	depends !LCD4LINUX_HAS_AT_LEAST_ONE_PLUGIN

config LCD4LINUX_PLUGIN_apm
	bool
	prompt "apm"
	select LCD4LINUX_HAS_AT_LEAST_ONE_PLUGIN

config LCD4LINUX_PLUGIN_asterisk
	bool
	prompt "asterisk"
	select LCD4LINUX_HAS_AT_LEAST_ONE_PLUGIN

config LCD4LINUX_PLUGIN_button_exec
	bool
	prompt "button_exec"
	select LCD4LINUX_HAS_AT_LEAST_ONE_PLUGIN

config LCD4LINUX_PLUGIN_cpuinfo
	bool
	prompt "cpuinfo"
	select LCD4LINUX_HAS_AT_LEAST_ONE_PLUGIN
	default y

config LCD4LINUX_PLUGIN_dbus
	bool
	prompt "dbus"
	select LCD4LINUX_HAS_AT_LEAST_ONE_PLUGIN
	select LCD4LINUX_NEEDS_libdbus

config LCD4LINUX_PLUGIN_diskstats
	bool
	prompt "diskstats"
	select LCD4LINUX_HAS_AT_LEAST_ONE_PLUGIN

config LCD4LINUX_PLUGIN_dvb
	bool
	prompt "dvb"
	select LCD4LINUX_HAS_AT_LEAST_ONE_PLUGIN

config LCD4LINUX_PLUGIN_event
	bool
	prompt "event"
	select LCD4LINUX_HAS_AT_LEAST_ONE_PLUGIN

config LCD4LINUX_PLUGIN_exec
	bool
	prompt "exec"
	select LCD4LINUX_HAS_AT_LEAST_ONE_PLUGIN
	
config LCD4LINUX_PLUGIN_fifo
	bool
	prompt "fifo"
	select LCD4LINUX_HAS_AT_LEAST_ONE_PLUGIN

config LCD4LINUX_PLUGIN_file
	bool
	prompt "file"
	select LCD4LINUX_HAS_AT_LEAST_ONE_PLUGIN

config LCD4LINUX_PLUGIN_gps
	bool
	prompt "gps"
	select LCD4LINUX_HAS_AT_LEAST_ONE_PLUGIN
	select LCD4LINUX_NEEDS_libnmeap

config LCD4LINUX_PLUGIN_hddtemp
	bool
	prompt "hddtemp"
	select LCD4LINUX_HAS_AT_LEAST_ONE_PLUGIN

config LCD4LINUX_PLUGIN_huawei
	bool
	prompt "huawei"
	select LCD4LINUX_HAS_AT_LEAST_ONE_PLUGIN

config LCD4LINUX_PLUGIN_i2c_sensors
	bool
	prompt "i2c_sensors"
	select LCD4LINUX_HAS_AT_LEAST_ONE_PLUGIN

config LCD4LINUX_PLUGIN_iconv
	bool
	prompt "iconv"
	select LCD4LINUX_HAS_AT_LEAST_ONE_PLUGIN
	select LCD4LINUX_NEEDS_libiconv

config LCD4LINUX_PLUGIN_imon
	bool
	prompt "imon"
	select LCD4LINUX_HAS_AT_LEAST_ONE_PLUGIN

config LCD4LINUX_PLUGIN_isdn
	bool
	prompt "isdn"
	select LCD4LINUX_HAS_AT_LEAST_ONE_PLUGIN

config LCD4LINUX_PLUGIN_kvv
	bool
	prompt "kvv"
	select LCD4LINUX_HAS_AT_LEAST_ONE_PLUGIN

config LCD4LINUX_PLUGIN_loadavg
	bool
	prompt "loadavg"
	select LCD4LINUX_HAS_AT_LEAST_ONE_PLUGIN
	default y

config LCD4LINUX_PLUGIN_meminfo
	bool
	prompt "meminfo"
	select LCD4LINUX_HAS_AT_LEAST_ONE_PLUGIN
	default y

config LCD4LINUX_PLUGIN_mpd
	bool
	prompt "mpd"
	select LCD4LINUX_HAS_AT_LEAST_ONE_PLUGIN

config LCD4LINUX_PLUGIN_mpris_dbus
	bool
	prompt "mpris_dbus"
	select LCD4LINUX_HAS_AT_LEAST_ONE_PLUGIN
	select LCD4LINUX_NEEDS_libdbus

config LCD4LINUX_PLUGIN_mysql
	bool
	prompt "mysql"
	select LCD4LINUX_HAS_AT_LEAST_ONE_PLUGIN
	select LCD4LINUX_NEEDS_libmysqlclient

config LCD4LINUX_PLUGIN_netdev
	bool
	prompt "netdev"
	select LCD4LINUX_HAS_AT_LEAST_ONE_PLUGIN

config LCD4LINUX_PLUGIN_netinfo
	bool
	prompt "netinfo"
	select LCD4LINUX_HAS_AT_LEAST_ONE_PLUGIN

config LCD4LINUX_PLUGIN_pop3
	bool
	prompt "pop3"
	select LCD4LINUX_HAS_AT_LEAST_ONE_PLUGIN

config LCD4LINUX_PLUGIN_ppp
	bool
	prompt "ppp"
	select LCD4LINUX_HAS_AT_LEAST_ONE_PLUGIN
	select LCD4LINUX_NEEDS_ppp

config LCD4LINUX_PLUGIN_proc_stat
	bool
	prompt "proc_stat"
	select LCD4LINUX_HAS_AT_LEAST_ONE_PLUGIN
	default y

#config LCD4LINUX_PLUGIN_python
#	bool
#	prompt "python"
#	select LCD4LINUX_HAS_AT_LEAST_ONE_PLUGIN
#	select LCD4LINUX_NEEDS_python

config LCD4LINUX_PLUGIN_qnaplog
	bool
	prompt "qnaplog"
	select LCD4LINUX_HAS_AT_LEAST_ONE_PLUGIN
	select LCD4LINUX_NEEDS_libsqlite3

config LCD4LINUX_PLUGIN_seti
	bool
	prompt "seti"
	select LCD4LINUX_HAS_AT_LEAST_ONE_PLUGIN

config LCD4LINUX_PLUGIN_statfs
	bool
	prompt "statfs"
	select LCD4LINUX_HAS_AT_LEAST_ONE_PLUGIN

config LCD4LINUX_PLUGIN_uname
	bool
	prompt "uname"
	select LCD4LINUX_HAS_AT_LEAST_ONE_PLUGIN

config LCD4LINUX_PLUGIN_uptime
	bool
	prompt "uptime"
	select LCD4LINUX_HAS_AT_LEAST_ONE_PLUGIN
	default y

config LCD4LINUX_PLUGIN_w1retap
	bool
	prompt "w1retap"
	select LCD4LINUX_HAS_AT_LEAST_ONE_PLUGIN

config LCD4LINUX_PLUGIN_wireless
	bool
	prompt "wireless"
	select LCD4LINUX_HAS_AT_LEAST_ONE_PLUGIN
	depends BROKEN

config LCD4LINUX_PLUGIN_xmms
	bool
	prompt "xmms"
	select LCD4LINUX_HAS_AT_LEAST_ONE_PLUGIN
```

## packages_10.03.1/net/strongswan4/Config.in
```kconfig
menu "Configuration"
	depends on PACKAGE_strongswan4

# --enable-cisco-quirks
config STRONGSWAN4_ENABLE_CISCO_QUIRKS
	bool
	prompt "Enable support of Cisco VPN client"
	default y

# --enable-nat-transport
config STRONGSWAN4_ENABLE_NAT_TRANSPORT
	bool
	prompt "Enable NAT traversal with IPsec transport mode in"
	default y

# --enable-vendor-id
config STRONGSWAN4_ENABLE_VENDOR_ID
	bool
	prompt "Enable sending of the strongSwan vendor ID"
	default y

# --enable-xauth-vid
config STRONGSWAN4_ENABLE_XAUTH_VID
	bool
	prompt "Enable sending of the XAUTH vendor ID"
	default y

# --with-random-device
config STRONGSWAN4_DEVICE_RANDOM
	string
	prompt "Set the device to read real random data from"
	default "/dev/random"

# --with-urandom-device
config STRONGSWAN4_DEVICE_URANDOM
	string
	prompt "Set the device to read pseudo random data from"
	default "/dev/urandom"

# --with-routing-table
config STRONGSWAN4_ROUTING_TABLE
	string
	prompt "Set the IPsec routing table ID"
	default "220"

#  --with-routing-table-prio
config STRONGSWAN4_ROUTING_TABLE_PRIO
	string
	prompt "Set the IPsec routing table priority"
	default "220"

endmenu
```

## tags/whiterussian_0.9/package/base-files/Config.in
```kconfig
config BR2_PACKAGE_LIBGCC
	tristate "libgcc - GCC support library"
	default m if CONFIG_DEVEL
	help
	  GCC support library
```

## tags/whiterussian_0.9/package/dsl-qos-queue/Config.in
```kconfig
config BR2_PACKAGE_DSL_QOS_QUEUE
	tristate "dsl-qos-queue - ADSL/ATM Bandwith management"
	default m if CONFIG_DEVEL
	select BR2_PACKAGE_KMOD_IPT_QUEUE
	help
	  This program implements a user space QUEUE processor which controls outbound traffic
	  over a DSL modem using a pseudo- token-bucket-filter style queue with starvation protection.

	  Main feature of this outbound rate limiter is it's ability to rate limit based on the calculated
	  raw bandwidth used rather than just the IP bandwidth used. This provides a MUCH more accurate way
	  to prevent packet queueing in the network device (in this case, ADSL modem).

	  http://www.sonicspike.net/software/
```

## tags/whiterussian_0.9/package/ipkg/Config.in
```kconfig
config BR2_PACKAGE_IPKG
	tristate
	default n
	depends BR2_PACKAGE_IPKG_C || BR2_PACKAGE_IPKG_SH

config BR2_PACKAGE_IPKG_C
	tristate "ipkg - itsy package management system"
	default y
	select BR2_PACKAGE_IPKG
	help
	 Lightweight package management system
	 ipkg is the Itsy Package Management System, for handling
	 installation and removal of packages on a system. It can
	 recursively follow dependencies and download all packages
	 necessary to install a particular package.
	 
	 ipkg knows how to install both .ipk and .deb packages.

	 ipkg is intended to serve the same functions (and more) for
	 Familiar that dpkg and apt serve for Debian, (while taking
	 up much less space).
	 
config BR2_PACKAGE_IPKG_SH
	tristate "ipkg-sh - itsy package management system (shell version)"
	default m if CONFIG_DEVEL
	default m if BR2_PACKAGE_IMAGEBUILDER
	select BR2_PACKAGE_IPKG
	help
	 Lightweight package management system
	 ipkg is the Itsy Package Management System, for handling
	 installation and removal of packages on a system. It can
	 recursively follow dependencies and download all packages
	 necessary to install a particular package.
	 
	 ipkg knows how to install both .ipk and .deb packages.

	 ipkg is intended to serve the same functions (and more) for
	 Familiar that dpkg and apt serve for Debian, (while taking
	 up much less space).

if (BR2_PACKAGE_IPKG_C = y) && (BR2_PACKAGE_IPKG_SH = y)
	comment "WARNING: both ipkg and ipkg-sh are selected for installation !"
endif
```

## tags/whiterussian_0.9/package/mysql/Config.in
```kconfig
config BR2_PACKAGE_MYSQL
	tristate
	default n
	depends BR2_PACKAGE_LIBMYSQLCLIENT

config BR2_PACKAGE_LIBMYSQLCLIENT
	prompt "libmysqlclient - MySQL client library"
	tristate
	default m if CONFIG_DEVEL
	select BR2_PACKAGE_MYSQL
	help
	  MySQL client library.
	  
	  http://dev.mysql.com/
	  
```
